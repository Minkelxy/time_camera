## firmware/sdkconfig.defaults
```kconfig
# ============================================================================
# sdkconfig.defaults
# 户外定时拍照固件 - ESP32-S3 默认配置
# 说明：本文件提供 idf.py menuconfig 之前的默认值，最终配置以 sdkconfig 为准。
# ============================================================================

# ----------------------------------------------------------------------------
# 目标芯片
# ----------------------------------------------------------------------------
CONFIG_IDF_TARGET="esp32s3"
CONFIG_IDF_TARGET_ESP32S3=y

# ----------------------------------------------------------------------------
# Flash 配置 (4MB)
# ----------------------------------------------------------------------------
CONFIG_ESPTOOLPY_FLASHSIZE_4MB=y
CONFIG_ESPTOOLPY_FLASHSIZE="4MB"
CONFIG_ESPTOOLPY_FLASHMODE_DIO=y
CONFIG_ESPTOOLPY_FLASHFREQ_40M=y

# ----------------------------------------------------------------------------
# 分区表 (自定义 partitions.csv)
# ----------------------------------------------------------------------------
CONFIG_PARTITION_TABLE_CUSTOM=y
CONFIG_PARTITION_TABLE_CUSTOM_FILENAME="partitions.csv"
CONFIG_PARTITION_TABLE_FILENAME="partitions.csv"
CONFIG_PARTITION_TABLE_OFFSET=0x8000

# ----------------------------------------------------------------------------
# PSRAM (8MB, 四线 Quad)
# ----------------------------------------------------------------------------
CONFIG_ESP32S3_SPIRAM_SUPPORT=y
CONFIG_SPIRAM_TYPE_QUAD=y
CONFIG_SPIRAM_SIZE=8388608
CONFIG_SPIRAM_SPEED_64M=y
CONFIG_SPIRAM_USE_MALLOC=y
CONFIG_SPIRAM_MALLOC_ALWAYSINTERNAL=16384
CONFIG_SPIRAM_MALLOC_RESERVE_INTERNAL=32768
CONFIG_SPIRAM_TRY_ALLOCATE_WIFI_LWIP=y

# esp_camera 组件依赖 PSRAM 支持
CONFIG_ESP32_SPIRAM_SUPPORT=y

# ----------------------------------------------------------------------------
# FATFS 文件系统 (长文件名 + SD 卡)
# ----------------------------------------------------------------------------
CONFIG_FATFS_SUPPORT=y
CONFIG_FATFS_LONG_FILENAMES=y
CONFIG_FATFS_LFN_HEAP=y
CONFIG_FATFS_CODEPAGE=936
CONFIG_FATFS_MAX_LFN=255
CONFIG_FATFS_VFS_FAT_BLKDEV=y
CONFIG_FATFS_SECTOR_4096=y
CONFIG_FATFS_PER_MOUNT_CACHE=4

# SDMMC / SDSPI 驱动
CONFIG_SDMMC_ENABLE_CPU_DMA=y

# ----------------------------------------------------------------------------
# WiFi / 网络协议栈
# ----------------------------------------------------------------------------
CONFIG_ESP_WIFI_ENABLED=y
CONFIG_ESP_WIFI_NVS_ENABLED=y
CONFIG_ESP_WIFI_SOFTAP_SUPPORT=y
CONFIG_ESP_WIFI_STA_SUPPORT=y

# HTTP 客户端
CONFIG_ESP_HTTP_CLIENT_ENABLE_HTTPS=y
CONFIG_ESP_HTTPS_SERVER_ENABLE=y

# HTTP 服务器 (Web 配置门户)
CONFIG_ESP_HTTP_SERVER=y

# ----------------------------------------------------------------------------
# 蓝牙 (关闭以减小体积、降低功耗)
# ----------------------------------------------------------------------------
CONFIG_BT=n
CONFIG_BT_NIMBLE=n
CONFIG_BTDM_CTRL_HCI_MODE_VHCI=n

# ----------------------------------------------------------------------------
# FreeRTOS / 任务看门狗 (短任务场景禁用，避免拍照阻塞触发复位)
# ----------------------------------------------------------------------------
CONFIG_ESP_TASK_WDT=n
CONFIG_ESP_TASK_WDT_TIMEOUT_S=5
CONFIG_FREERTOS_HZ=1000
CONFIG_FREERTOS_TASK_CREATE_ALLOW_EXT_MEM=y

# ----------------------------------------------------------------------------
# 日志 (默认 INFO 级别)
# ----------------------------------------------------------------------------
CONFIG_LOG_DEFAULT_LEVEL_INFO=y
CONFIG_LOG_DEFAULT_LEVEL=3
CONFIG_LOG_COLORS=y
CONFIG_LOG_TIMESTAMP_SOURCE_RTOS=y

# ----------------------------------------------------------------------------
# LWIP TCP/MSS 调优 (弱网 / 高延迟回传场景)
# ----------------------------------------------------------------------------
CONFIG_LWIP_TCP_MSS=1440
CONFIG_LWIP_TCP_SND_BUF_DEFAULT=5760
CONFIG_LWIP_TCP_WND_DEFAULT=5760
CONFIG_LWIP_TCP_RECVMBOX_SIZE=6
CONFIG_LWIP_TCP_ACCEPTMBOX_SIZE=6
CONFIG_LWIP_TCP_MSL=6000
CONFIG_LWIP_SO_REUSE=y
CONFIG_LWIP_MAX_SOCKETS=10

# ----------------------------------------------------------------------------
# 代码优化 (减小体积)
# ----------------------------------------------------------------------------
CONFIG_COMPILER_OPTIMIZATION_SIZE=y
CONFIG_COMPILER_STRIP_UNUSED_SYMS=y

# ----------------------------------------------------------------------------
# 关闭不必要的组件以减小体积
# ----------------------------------------------------------------------------
CONFIG_MBEDTLS=n
CONFIG_ESP_COREDUMP_ENABLE_TO_FLASH=n
CONFIG_ESP_COREDUMP_ENABLE_TO_UART=n
CONFIG_ESP_SYSTEM_PANIC_PRINT_REBOOT=y
CONFIG_ESP_MAIN_TASK_STACK_SIZE=8192

# ----------------------------------------------------------------------------
# 硬件异常 / 看门狗复位后行为
# ----------------------------------------------------------------------------
CONFIG_ESP_SYSTEM_CHECK_INT_LEVEL_5=n
CONFIG_ESP_PANIC_HANDLER_IRAM=n
```
